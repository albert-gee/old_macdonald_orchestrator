## components/wifi_interface/Kconfig.projbuild
```kconfig
menu "Wi‑Fi AP defaults"
    config WIFI_AP_SSID_DEFAULT
        string "Default AP SSID"
        default "Old_MacDonald_AP"

    config WIFI_AP_PASS_DEFAULT
        string "Default AP password (min 8 chars)"
        default "123456789"
endmenu
```

## main/Kconfig.projbuild
```kconfig
menu "Old Macdonald - Matter Controller Defaults"

    config MATTER_CONTROLLER_NODE_ID_DEFAULT
        hex "Default Node ID of Matter Controller"
        default 0x123456789ABCDEF0
        range 0 0xFFFFFFFFFFFFFFFF
        help
            Default Node ID of Matter Controller.
            This is the unique identifier for the Matter Controller in the network.
            The default value is 0x123456789ABCDEF0, which is a random value.
            You can change this value to any valid Node ID between 0 and 0xFFFFFFFFFFFFFFFF.

    config MATTER_CONTROLLER_FABRIC_ID_DEFAULT
        hex "Default Fabric ID of Matter Controller"
        default 0x12345678
        range 0 0xFFFFFFFF
        help
            Default Fabric ID of Matter Controller.
            This is the unique identifier for the fabric in the network.
            The default value is 0x12345678, which is a random value.
            You can change this value to any valid Fabric ID between 0 and 0xFFFFFFFF.

    config MATTER_CONTROLLER_LISTEN_PORT_DEFAULT
        int "Default Listen Port of Matter Controller"
        default 5540
        range 1 65535
        help
            Default Listen Port of Matter Controller.
            This is the port that the Matter Controller will listen on for incoming connections.
            The default value is 5540, which is the standard port for Matter communication.
            You can change this value to any valid port number between 1 and 65535.



endmenu
```

## sdkconfig.defaults
```kconfig
CONFIG_ESPTOOLPY_FLASHSIZE_8MB=y


CONFIG_SYSTEM_EVENT_TASK_STACK_SIZE=32768
CONFIG_MAIN_TASK_STACK_SIZE=32768

# Wi-Fi
CONFIG_ENABLE_WIFI_STATION=y
CONFIG_DEFAULT_WIFI_SSID=""
CONFIG_DEFAULT_WIFI_PASSWORD=""
CONFIG_ENABLE_WIFI_AP=n

# OpenThread
CONFIG_OPENTHREAD_RADIO_SPINEL_UART=y
CONFIG_OPENTHREAD_ENABLED=y
CONFIG_OPENTHREAD_BORDER_ROUTER=y
CONFIG_OPENTHREAD_SRP_CLIENT=n
CONFIG_OPENTHREAD_DNS_CLIENT=n
CONFIG_THREAD_TASK_STACK_SIZE=8192


CONFIG_OPENTHREAD_NETWORK_NAME="OpenThread-ESP"
CONFIG_OPENTHREAD_MESH_LOCAL_PREFIX="fd00:db8:a0:0::/64"
CONFIG_OPENTHREAD_NETWORK_CHANNEL=15
CONFIG_OPENTHREAD_NETWORK_PANID=0x1234
CONFIG_OPENTHREAD_NETWORK_EXTPANID="dead00beef00cafe"
CONFIG_OPENTHREAD_NETWORK_MASTERKEY="3657e7d09ae5ba4cb6aa82e7de4bb401"
CONFIG_OPENTHREAD_NETWORK_PSKC="104810e2315100afd6bc9215a6bfac53"

# LwIP
CONFIG_LWIP_IPV6_AUTOCONFIG=y
CONFIG_LWIP_IPV6_NUM_ADDRESSES=12
CONFIG_LWIP_MULTICAST_PING=y
CONFIG_LWIP_IPV6_FORWARD=y
CONFIG_LWIP_HOOK_IP6_ROUTE_DEFAULT=y
CONFIG_LWIP_HOOK_ND6_GET_GW_DEFAULT=y
CONFIG_LWIP_NETIF_STATUS_CALLBACK=y

# BT
CONFIG_BT_ENABLED=y
CONFIG_BT_NIMBLE_ENABLED=y
CONFIG_ENABLE_ESP32_BLE_CONTROLLER=y

# Partition table
CONFIG_PARTITION_TABLE_CUSTOM=y
CONFIG_PARTITION_TABLE_CUSTOM_FILENAME="partitions.csv"

# mbedTLS
CONFIG_MBEDTLS_KEY_EXCHANGE_ECJPAKE=y
CONFIG_MBEDTLS_ECJPAKE_C=y
CONFIG_MBEDTLS_SSL_PROTO_DTLS=y

# MDNS platform
CONFIG_USE_MINIMAL_MDNS=n
CONFIG_ENABLE_EXTENDED_DISCOVERY=y
CONFIG_MDNS_MULTIPLE_INSTANCE=y

# CHIP-shell
CONFIG_ENABLE_CHIP_SHELL=y
CONFIG_ESP_MATTER_CONSOLE_TASK_STACK=4096
CONFIG_CHIP_SHELL_CMD_LINE_BUF_MAX_LENGTH=512

# Matter
CONFIG_CHIP_TASK_STACK_SIZE=15360
CONFIG_ESP_MAIN_TASK_STACK_SIZE=8192
CONFIG_ESP_MATTER_ENABLE_MATTER_SERVER=n
CONFIG_ENABLE_CHIP_CONTROLLER_BUILD=y
CONFIG_ESP_MATTER_CONTROLLER_ENABLE=y
CONFIG_ESP_MATTER_COMMISSIONER_ENABLE=y
CONFIG_BUILD_CHIP_TESTS=n
CONFIG_CHIP_PROJECT_CONFIG="main/include/matter_project_config.h"

# OTA Requestor
CONFIG_ENABLE_OTA_REQUESTOR=n

# Disable route hook for matter since OTBR has already initialize the route hook
CONFIG_ENABLE_ROUTE_HOOK=n

# Use USB Jtag Console
CONFIG_ESP_CONSOLE_USB_SERIAL_JTAG=y

# SPIRAM
CONFIG_SPIRAM=y
CONFIG_SPIRAM_MODE_QUAD=y
CONFIG_SPIRAM_SPEED_80M=y
CONFIG_SPIRAM_MALLOC_ALWAYSINTERNAL=512
CONFIG_SPIRAM_MALLOC_RESERVE_INTERNAL=16384
CONFIG_SPIRAM_ALLOW_BSS_SEG_EXTERNAL_MEMORY=y
CONFIG_SPIRAM_TRY_ALLOCATE_WIFI_LWIP=y
CONFIG_BT_NIMBLE_MEM_ALLOC_MODE_EXTERNAL=y
CONFIG_ESP_MATTER_MEM_ALLOC_MODE_EXTERNAL=y
CONFIG_MBEDTLS_EXTERNAL_MEM_ALLOC=y

# HKDF for mbedtls
CONFIG_MBEDTLS_HKDF_C=y

# Disable WiFi&Thread network commissioning driver
CONFIG_WIFI_NETWORK_COMMISSIONING_DRIVER=n
CONFIG_THREAD_NETWORK_COMMISSIONING_DRIVER=n

# Enable WebSocket server feature
CONFIG_HTTPD_WS_SUPPORT=y
```
